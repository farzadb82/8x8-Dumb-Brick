#include <LedControl.h>
#include <avr/pgmspace.h>


#define DEVICES  1
#define DIN_PIN  0
#define CS_PIN   1
#define CLK_PIN  2
#define IR_SENSOR 4
#define LED_OUT   3


LedControl lc = LedControl(DIN_PIN, CLK_PIN, CS_PIN, DEVICES);

byte frame_buffer[8] = { 0, 0, 0, 0, 0, 0, 0, 0 };

const byte message_data[] PROGMEM = {
    B01111111,  // H
    B00001000,
    B00001000,
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    B00000000,
    B00000000
};

const byte song_data[] PROGMEM = {
    B01111110,  // A
    B00010001,
    B00010001,
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    B00000000,
    B00000000
};


ISR(PCINT0_vect) {
    digitalWrite(LED_OUT, digitalRead(IR_SENSOR));
}

void setup() {
    for (int x=0; x<DEVICES; x++){
        lc.shutdown(x,false);       //The MAX72XX is in power-saving mode on startup
        lc.setIntensity(x, 3);      // Set the brightness to default value
        lc.clearDisplay(x);         // and clear the display
    }
    //pinMode(IR_SENSOR, INPUT);
    //pinMode(LED_OUT, OUTPUT);

    //GIMSK = _BV(PCIE);    // Enable pin change interrupt
    //PCMSK = _BV(PCINT4);  // Enable the interrupt for only pin 4.

    lc.setLed(0, 0, 0, 1);
    delay(500);
    lc.setLed(0, 0, 0, 0);
    delay(500);
    lc.setLed(0, 0, 0, 1);
    delay(500);
    lc.setLed(0, 0, 0, 0);
    delay(2500);
}


void loop() {
    int frame_delay = 65;
    for (int idx=0; idx<sizeof(message_data); idx++) {
        shift_display(pgm_read_byte_near(message_data + idx));
        show_display_buffer();
        delay(frame_delay);
    }
    delay(10000);
    frame_delay = 30;
    for (int idx=0; idx<sizeof(song_data); idx++) {
        shift_display(pgm_read_byte_near(song_data + idx));
        show_display_buffer();
        delay(frame_delay);
    }
    delay(5000);
}

void shift_display(byte next_col) {
    for (byte row=0; row<sizeof(frame_buffer); row++) {
        frame_buffer[row] = frame_buffer[row] << 1 | bitRead(next_col, row);
    }
}

void show_display_buffer() {
    byte tmp_buffer[8] = { 0, 0, 0, 0, 0, 0, 0, 0 };

    for (byte row=0; row<sizeof(tmp_buffer); row++) {
        for (byte col=0; col<8; col++) {
            bitWrite(tmp_buffer[7-col], row, bitRead(frame_buffer[7-row], 7-col));
            //lc.setLed(0, 7-col, row, bitRead(display_buffer[row], col));
            //delay(100);
        }
    }

    for (int row=0; row<sizeof(tmp_buffer); row++) {
        lc.setRow(0, row, tmp_buffer[row]);
    }
}

